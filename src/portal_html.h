#pragma once
#include <pgmspace.h>

// Setup portal page. {{TOKENS}} are substituted at runtime.
// The murmuration mark, generated by murmur-core/tools/murmuration.py.
static const char kPortalHead[] PROGMEM = R"HTML(<!doctype html><html lang="en"><head>
<meta charset="utf-8"><meta name="viewport" content="width=device-width,initial-scale=1">
<title>Murmur setup</title>
<style>
:root{--bg:#0a0b0d;--s:#141518;--s2:#1b1d21;--l:rgba(255,255,255,.08);--t:#f4f5f7;--t2:#a2a6ad;--t3:#686c74;--a:#3e6ae1;--e:#ef5a5f;--g:#34c77b;
--m:ui-monospace,Menlo,Consolas,monospace}
*{box-sizing:border-box}body{margin:0;background:var(--bg);color:var(--t);font:15px/1.45 -apple-system,BlinkMacSystemFont,"Segoe UI",Roboto,sans-serif;-webkit-font-smoothing:antialiased}
main{max-width:520px;margin:0 auto;padding:28px 16px 48px}
.eb{font:11px var(--m);letter-spacing:.16em;text-transform:uppercase;color:var(--t3)}
h1{font-weight:300;font-size:34px;letter-spacing:-.02em;margin:6px 0 4px}
p.sub{color:var(--t2);margin:0 0 22px}
.card{background:var(--s);border:1px solid var(--l);border-radius:16px;padding:20px;margin-bottom:14px}
h2{font-size:12px;font-weight:500;line-height:1;letter-spacing:.14em;text-transform:uppercase;color:var(--t2);margin:0 0 2px}
label{display:block;font:10.5px var(--m);letter-spacing:.12em;text-transform:uppercase;color:var(--t3);margin:14px 0 6px}
input,select{width:100%;height:44px;padding:0 13px;border-radius:10px;border:1px solid var(--l);background:var(--s2);color:var(--t);font:inherit;outline:none}
input:focus,select:focus{border-color:var(--a)}
select{appearance:none}
.row{display:grid;grid-template-columns:1fr 1fr;gap:12px}.row3{display:grid;grid-template-columns:1fr 1fr 1fr;gap:12px}
.hint{font-size:12.5px;color:var(--t3);margin-top:6px}
details summary{cursor:pointer;color:var(--t2);list-style:none;font-size:14px}
details summary::after{content:" +";color:var(--t3)}details[open] summary::after{content:" −"}
.chk{display:flex;align-items:center;gap:10px;margin-top:16px;font-size:14px;color:var(--t2);text-transform:none;letter-spacing:0;font-family:inherit}
.chk input{width:18px;height:18px;accent-color:var(--a)}
button{width:100%;height:48px;border:0;border-radius:999px;background:var(--a);color:#fff;cursor:pointer;margin-top:6px;font-size:15px;font-weight:500;font-family:inherit}
.err{background:rgba(239,90,95,.12);color:var(--e);border-radius:10px;padding:10px 14px;margin-bottom:14px;font-size:14px}
.ok{text-align:center;padding:60px 0}.ok .dot{width:12px;height:12px;border-radius:50%;background:var(--g);margin:0 auto 18px;box-shadow:0 0 0 6px rgba(52,199,123,.15)}
.logo{width:44px;height:44px;color:var(--t);display:block;margin-bottom:18px}
.id{font:12px var(--m);color:var(--t2);background:var(--s2);padding:3px 8px;border-radius:6px}
</style></head><body><main>
<svg class="logo" aria-hidden="true" xmlns="http://www.w3.org/2000/svg" viewBox="-5.8 5.9 86.8 86.8"><g fill="currentColor"><ellipse cx="64.8" cy="44.0" rx="4.2" ry="1.8" transform="rotate(91 64.8 44.0)" opacity="0.97"/><ellipse cx="24.9" cy="35.1" rx="4.3" ry="1.9" transform="rotate(-41 24.9 35.1)" opacity="1.00"/><ellipse cx="55.7" cy="55.1" rx="3.2" ry="1.4" transform="rotate(172 55.7 55.1)" opacity="0.75"/><ellipse cx="19.7" cy="55.4" rx="3.2" ry="1.4" transform="rotate(-75 19.7 55.4)" opacity="0.73"/><ellipse cx="50.4" cy="63.0" rx="2.3" ry="1.0" transform="rotate(-141 50.4 63.0)" opacity="0.48"/><ellipse cx="10.1" cy="30.2" rx="2.1" ry="0.9" transform="rotate(-51 10.1 30.2)" opacity="0.40"/><ellipse cx="69.9" cy="55.2" rx="2.4" ry="1.1" transform="rotate(122 69.9 55.2)" opacity="0.52"/><ellipse cx="14.3" cy="71.2" rx="4.2" ry="1.9" transform="rotate(-104 14.3 71.2)" opacity="0.98"/><ellipse cx="63.1" cy="50.5" rx="3.9" ry="1.7" transform="rotate(96 63.1 50.5)" opacity="0.90"/><ellipse cx="46.4" cy="47.7" rx="2.0" ry="0.9" transform="rotate(-30 46.4 47.7)" opacity="0.35"/><ellipse cx="44.6" cy="52.9" rx="3.6" ry="1.6" transform="rotate(-110 44.6 52.9)" opacity="0.84"/><ellipse cx="47.6" cy="19.7" rx="2.5" ry="1.1" transform="rotate(14 47.6 19.7)" opacity="0.54"/><ellipse cx="17.0" cy="81.0" rx="3.3" ry="1.4" transform="rotate(-115 17.0 81.0)" opacity="0.75"/><ellipse cx="14.5" cy="58.9" rx="3.9" ry="1.7" transform="rotate(-97 14.5 58.9)" opacity="0.91"/><ellipse cx="9.2" cy="54.7" rx="3.8" ry="1.7" transform="rotate(-63 9.2 54.7)" opacity="0.88"/><ellipse cx="8.7" cy="44.8" rx="3.4" ry="1.5" transform="rotate(-71 8.7 44.8)" opacity="0.79"/><ellipse cx="2.0" cy="48.5" rx="2.4" ry="1.1" transform="rotate(-73 2.0 48.5)" opacity="0.52"/><ellipse cx="18.9" cy="46.1" rx="3.9" ry="1.7" transform="rotate(-67 18.9 46.1)" opacity="0.90"/><ellipse cx="28.5" cy="27.1" rx="3.5" ry="1.5" transform="rotate(-2 28.5 27.1)" opacity="0.82"/><ellipse cx="47.7" cy="37.8" rx="2.8" ry="1.2" transform="rotate(8 47.7 37.8)" opacity="0.62"/><ellipse cx="25.8" cy="55.0" rx="2.0" ry="0.9" transform="rotate(-73 25.8 55.0)" opacity="0.38"/><ellipse cx="37.3" cy="31.5" rx="4.0" ry="1.8" transform="rotate(-2 37.3 31.5)" opacity="0.94"/><ellipse cx="60.2" cy="34.3" rx="4.2" ry="1.8" transform="rotate(54 60.2 34.3)" opacity="0.98"/><ellipse cx="19.4" cy="28.2" rx="3.0" ry="1.3" transform="rotate(-40 19.4 28.2)" opacity="0.68"/><ellipse cx="37.3" cy="22.6" rx="3.2" ry="1.4" transform="rotate(-11 37.3 22.6)" opacity="0.73"/><ellipse cx="33.1" cy="43.4" rx="2.4" ry="1.0" transform="rotate(-59 33.1 43.4)" opacity="0.49"/><ellipse cx="70.6" cy="37.1" rx="2.7" ry="1.2" transform="rotate(94 70.6 37.1)" opacity="0.60"/><ellipse cx="40.7" cy="36.4" rx="3.1" ry="1.4" transform="rotate(1 40.7 36.4)" opacity="0.71"/><ellipse cx="60.6" cy="58.8" rx="3.6" ry="1.6" transform="rotate(158 60.6 58.8)" opacity="0.84"/><ellipse cx="6.9" cy="60.3" rx="3.3" ry="1.5" transform="rotate(-75 6.9 60.3)" opacity="0.77"/><ellipse cx="54.1" cy="40.0" rx="2.7" ry="1.2" transform="rotate(54 54.1 40.0)" opacity="0.61"/><ellipse cx="6.7" cy="35.2" rx="2.2" ry="1.0" transform="rotate(-58 6.7 35.2)" opacity="0.46"/><ellipse cx="21.1" cy="71.9" rx="2.6" ry="1.1" transform="rotate(-127 21.1 71.9)" opacity="0.58"/><ellipse cx="48.2" cy="58.5" rx="4.0" ry="1.7" transform="rotate(-187 48.2 58.5)" opacity="0.93"/><ellipse cx="69.6" cy="47.5" rx="3.3" ry="1.5" transform="rotate(90 69.6 47.5)" opacity="0.77"/><ellipse cx="38.4" cy="17.5" rx="2.1" ry="0.9" transform="rotate(-20 38.4 17.5)" opacity="0.38"/><ellipse cx="58.7" cy="44.5" rx="2.7" ry="1.2" transform="rotate(66 58.7 44.5)" opacity="0.61"/><ellipse cx="1.5" cy="58.2" rx="2.2" ry="1.0" transform="rotate(-73 1.5 58.2)" opacity="0.45"/><ellipse cx="73.7" cy="42.9" rx="2.2" ry="0.9" transform="rotate(85 73.7 42.9)" opacity="0.43"/><ellipse cx="43.2" cy="26.2" rx="3.8" ry="1.7" transform="rotate(-8 43.2 26.2)" opacity="0.89"/><ellipse cx="55.1" cy="61.5" rx="3.2" ry="1.4" transform="rotate(168 55.1 61.5)" opacity="0.74"/><ellipse cx="51.4" cy="28.2" rx="4.0" ry="1.7" transform="rotate(-6 51.4 28.2)" opacity="0.92"/><ellipse cx="21.7" cy="61.1" rx="2.3" ry="1.0" transform="rotate(-115 21.7 61.1)" opacity="0.49"/><ellipse cx="37.6" cy="40.8" rx="2.4" ry="1.0" transform="rotate(-11 37.6 40.8)" opacity="0.51"/><ellipse cx="7.6" cy="66.3" rx="3.2" ry="1.4" transform="rotate(-105 7.6 66.3)" opacity="0.73"/><ellipse cx="45.1" cy="33.4" rx="3.6" ry="1.6" transform="rotate(8 45.1 33.4)" opacity="0.83"/><ellipse cx="24.4" cy="43.5" rx="3.4" ry="1.5" transform="rotate(-68 24.4 43.5)" opacity="0.79"/><ellipse cx="23.4" cy="22.5" rx="2.4" ry="1.0" transform="rotate(-11 23.4 22.5)" opacity="0.50"/><ellipse cx="32.0" cy="34.7" rx="3.8" ry="1.7" transform="rotate(-14 32.0 34.7)" opacity="0.88"/><ellipse cx="63.8" cy="28.3" rx="2.8" ry="1.2" transform="rotate(43 63.8 28.3)" opacity="0.62"/><ellipse cx="43.5" cy="40.6" rx="2.0" ry="0.9" transform="rotate(-4 43.5 40.6)" opacity="0.37"/><ellipse cx="13.4" cy="33.3" rx="3.0" ry="1.3" transform="rotate(-55 13.4 33.3)" opacity="0.68"/><ellipse cx="21.7" cy="77.2" rx="3.1" ry="1.4" transform="rotate(-113 21.7 77.2)" opacity="0.71"/><ellipse cx="26.0" cy="49.4" rx="2.6" ry="1.2" transform="rotate(-76 26.0 49.4)" opacity="0.59"/><ellipse cx="15.8" cy="40.6" rx="4.0" ry="1.7" transform="rotate(-61 15.8 40.6)" opacity="0.93"/></g></svg>)HTML";

static const char kPortalForm[] PROGMEM = R"HTML(
<div class="eb">Murmur node · v{{FW}}</div>
<h1>Set up sensor</h1>
<p class="sub">Node <span class="id">{{ID}}</span>. Choose the sensor, join your Wi-Fi and point it at the broker on your Pi.</p>
{{ERROR}}
<form method="post" action="/save" autocomplete="off">
<div class="card"><h2>Sensor</h2>
<label for="sensor">Type</label>
<select id="sensor" name="sensor">{{SENSORS}}</select>
<div class="hint">DHT on GPIO{{PDATA}} · I2C on SDA GPIO{{PSDA}} / SCL GPIO{{PSCL}} (change under Advanced).</div>
<label for="name">Node name</label>
<input id="name" name="name" maxlength="48" value="{{NAME}}" placeholder="Living Room">
<label for="interval">Report every (seconds)</label>
<input id="interval" name="interval" type="number" min="2" max="3600" value="{{INTERVAL}}">
<label class="chk"><input id="battery" type="checkbox" name="battery" value="1" {{BATTERY}}>Battery mode</label>
<div class="hint">Deep sleep between reports; 5–15 minutes recommended. RESET opens a 5-minute window for commands and OTA.</div>
</div>
<div class="card"><h2>Wi-Fi</h2>
<label for="ssid">Network</label>
<input id="ssid" name="ssid" list="nets" maxlength="32" value="{{SSID}}" required placeholder="Network name">
<datalist id="nets">{{NETWORKS}}</datalist>
<label for="pass">Password</label>
<input id="pass" name="pass" type="password" maxlength="64" placeholder="{{PASS_PH}}">
</div>
<div class="card"><h2>MQTT broker</h2>
<div class="row"><div><label for="host">Host</label>
<input id="host" name="host" maxlength="64" value="{{HOST}}" required placeholder="192.168.1.10"></div>
<div><label for="port">Port</label><input id="port" name="port" type="number" min="1" max="65535" value="{{PORT}}"></div></div>
<div class="hint">IP address of the Pi, or its mDNS name such as raspberrypi.local.</div>
<div class="row"><div><label for="user">Username</label><input id="user" name="user" maxlength="32" value="{{USER}}" placeholder="optional"></div>
<div><label for="mpass">Password</label><input id="mpass" name="mpass" type="password" maxlength="64" placeholder="{{MPASS_PH}}"></div></div>
</div>
<div class="card"><details><summary>Advanced</summary>
<label for="base">Topic root</label><input id="base" name="base" maxlength="32" value="{{BASE}}">
<div class="row3"><div><label for="pdata">DHT pin</label><input id="pdata" name="pdata" type="number" value="{{PDATA}}"></div>
<div><label for="psda">SDA pin</label><input id="psda" name="psda" type="number" value="{{PSDA}}"></div>
<div><label for="pscl">SCL pin</label><input id="pscl" name="pscl" type="number" value="{{PSCL}}"></div></div>
<label for="ota">OTA update password</label><input id="ota" name="ota" type="password" maxlength="32" placeholder="{{OTA_PH}}">
<label class="chk"><input type="checkbox" name="lowtx" value="1" {{LOWTX}}>Reduced Wi-Fi power (fixes some SuperMini boards)</label>
</details></div>
<button type="submit">Save and connect</button>
</form>
<script>
document.getElementById('battery').addEventListener('change',e=>{const i=document.getElementById('interval');i.value=e.target.checked?Math.max(+i.value||30,300):30});
fetch('/scan').then(r=>r.json()).then(l=>{const d=document.getElementById('nets');l.forEach(n=>{if(![...d.options].some(o=>o.value===n)){const o=document.createElement('option');o.value=n;d.appendChild(o)}})}).catch(()=>{});
</script>)HTML";

static const char kPortalSaved[] PROGMEM = R"HTML(
<div class="ok"><div class="dot"></div><div class="eb">Saved</div>
<h1>Connecting…</h1>
<p class="sub">The node is restarting and joining <b>{{SSID}}</b>.<br>It will appear on your Murmur dashboard within a minute.<br><br>
If it doesn't, press RESET to reopen the maintenance window. If Wi-Fi cannot connect during that window, the <span class="id">Murmur-{{SHORT}}</span> setup network will return.</p></div>)HTML";

static const char kPortalTail[] PROGMEM = "</main></body></html>";
